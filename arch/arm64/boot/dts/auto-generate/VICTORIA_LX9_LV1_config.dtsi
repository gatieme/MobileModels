/**
 * Huawei Ltd.
 * PhosphorV660
 */


/include/ "VICTORIA_LX9_V4_config.dtsi"

/{
    hisi,boardid = <5 4 2 1>;
    hisi,boardname = "VICTORIA_LX9_LV1";
    hisi,modem_id = <0x3A022800>;
    sensorhub{
		als_sensor:light{
			als1{
				als_phone_version = <12>;
			};
		};
	};
};
