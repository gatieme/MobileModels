/**
 * Huawei Ltd.
 * PhosphorV660
 */


/include/ "VICTORIA_LX9_LV2_config.dtsi"

/{
    hisi,boardid = <5 4 2 7>;
    hisi,boardname = "VICTORIA_LX9_LV4";
    amba {
	i2c3: i2c@FDF0C000 {
		ti,lm36923{
				lm36923-boost-ctrl-1 = <0x6f>;/* inductor select bit4 set to 1, 4 mH */
				lm36923-boost-ctrl-dbc = <0x65>; /*reg val for dbc test*/
		};
	};
    };
};
