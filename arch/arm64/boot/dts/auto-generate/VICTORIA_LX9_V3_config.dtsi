/**
 * Huawei Ltd.
 * PhosphorV660
 */


/include/ "VICTORIA_LX9_V3_V101_config.dtsi"

/{
    hisi,boardid = <5 4 0 1>;
    hisi,boardname = "VICTORIA_LX9_V3";
    hisi,modem_id = <0x3A020C00>;
    hisi,gpu_arch = "mimir";
    hisi,camera_arch = "platform_v110";
};
