/**
 * Huawei Ltd.
 * PhosphorV660
 */

/dts-v1/;

/include/ "fastboot.dtsi"
/include/ "VICTORIA_TUGL_V4_config.dtsi"
/include/ "VICTORIA_TUGL_LV1_pin.dtsi"
/include/ "VICTORIA_TUGL_LV1_modem_pin.dtsi"
/include/ "VICTORIA_TUGL_LV1_hi6402_pin.dtsi"
/include/ "VICTORIA_TUGL_LV1_sec_pin.dtsi"

/{
    hisi,boardid = <5 4 2 0>;
    hisi,boardname = "VICTORIA_TUGL_LV1";
    hisi,modem_id = <0x3A022400>;

	sensorhub{
		als_sensor:light{
			als1{
				als_phone_version = <12>;
			};
		};
	};
};
