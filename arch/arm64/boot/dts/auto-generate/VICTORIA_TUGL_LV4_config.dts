/**
 * Huawei Ltd.
 * PhosphorV660
 */

/dts-v1/;

/include/ "fastboot.dtsi"
/include/ "VICTORIA_TUGL_LV2_config.dtsi"
/include/ "VICTORIA_TUGL_LV4_pin.dtsi"
/include/ "VICTORIA_TUGL_LV4_modem_pin.dtsi"
/include/ "VICTORIA_TUGL_LV4_hi6402_pin.dtsi"
/include/ "VICTORIA_TUGL_LV4_sec_pin.dtsi"

/{
    hisi,boardid = <5 4 2 6>;
    hisi,boardname = "VICTORIA_TUGL_LV4";
    amba {
	i2c3: i2c@FDF0C000 {
		ti,lm36923{
				lm36923-boost-ctrl-1 = <0x6f>;/* inductor select bit4 set to 1, 4 mH */
				lm36923-boost-ctrl-dbc = <0x65>; /*reg val for dbc test*/
		};
	};
    };
};
