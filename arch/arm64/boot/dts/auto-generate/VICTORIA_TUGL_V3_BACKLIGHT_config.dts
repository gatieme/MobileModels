/**
 * Huawei Ltd.
 * PhosphorV660
 */

/dts-v1/;

/include/ "fastboot.dtsi"
/include/ "VICTORIA_TUGL_V3_DPD_SKY2_5_config.dtsi"
/include/ "VICTORIA_TUGL_V3_BACKLIGHT_pin.dtsi"
/include/ "VICTORIA_TUGL_V3_BACKLIGHT_modem_pin.dtsi"
/include/ "VICTORIA_TUGL_V3_BACKLIGHT_hi6402_pin.dtsi"

/{
    hisi,boardid = <5 4 0 5>;
    hisi,boardname = "VICTORIA_TUGL_V3_BACKLIGHT";
    hisi,modem_id = <0x3A021000>;
    amba {
	i2c3: i2c@FDF0C000 {
		ti,lm36923{
			lm36923_hw_en_gpio = <54>;
		};
	};
    };
};
