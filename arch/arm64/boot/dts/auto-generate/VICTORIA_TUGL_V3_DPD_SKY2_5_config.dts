/**
 * Huawei Ltd.
 * PhosphorV660
 */

/dts-v1/;

/include/ "fastboot.dtsi"
/include/ "VICTORIA_TUGL_V3_config.dtsi"
/include/ "VICTORIA_TUGL_V3_DPD_SKY2_5_pin.dtsi"
/include/ "VICTORIA_TUGL_V3_DPD_SKY2_5_modem_pin.dtsi"
/include/ "VICTORIA_TUGL_V3_DPD_SKY2_5_hi6402_pin.dtsi"

/{
    hisi,boardid = <5 4 0 4>;
    hisi,boardname = "VICTORIA_TUGL_V3_DPD_SKY2_5";
    hisi,modem_id = <0x3A021800>;
};
