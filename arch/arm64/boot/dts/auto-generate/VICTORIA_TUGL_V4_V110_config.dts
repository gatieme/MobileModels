/**
 * Huawei Ltd.
 * PhosphorV660
 */

/dts-v1/;

/include/ "fastboot.dtsi"
/include/ "VICTORIA_TUGL_V3_BACKLIGHT_config.dtsi"
/include/ "VICTORIA_TUGL_V4_V110_pin.dtsi"
/include/ "VICTORIA_TUGL_V4_V110_modem_pin.dtsi"
/include/ "VICTORIA_TUGL_V4_V110_hi6402_pin.dtsi"
/include/ "VICTORIA_TUGL_V4_V110_sec_pin.dtsi"

/{
    hisi,boardid = <5 4 0 7>;
    hisi,boardname = "VICTORIA_TUGL_V4_V110";
    hisi,modem_id = <0x3A021C00>;

	sensorhub{
		als_sensor:light{
			als1{
				als_phone_version = <11>;
			};
		};
	};
};
