/{
	contexthub {
		flp_geofence {
			compatible = "hisilicon,flp_geofence";
			lpm = <0>;
			unavail_timeout = <30>;
			valid_accuracy = <50>;
			high_accuracy = <16>;
			min_off_time = <180>;
			prestart_time = <15>;
			vehicle_speed = <120>;
			riding_speed = <50>;
			walking_speed = <5>;
			running_speed = <36>;
		};
	};
};
