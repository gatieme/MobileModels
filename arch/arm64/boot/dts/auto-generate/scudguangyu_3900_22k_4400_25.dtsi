/* DO NOT EDIT - Automatically generated by python */
/ {
		scudguangyu_3900_22k_4400_25:scudguangyu_3900_22k_4400_25 {
			fcc = <3900>;
			default_rbatt_mohm = <100>;
			id_identify_min = <751>;
			id_identify_max = <1235>;
			id_voltage_min = <949>;
			id_voltage_max = <1051>;
			vbat_max = <4400>;
			temp_para = 
						"-32767","0","-1","0","4100","0",
						"0","5","-1","390","4400","0",
						"5","10","-1","1170","4400","3",
						"10","45","-1","-1","4400","3",
						"45","50","-1","1365","4400","3",
						"50","32767","-1","0","4400","0";
			vbat_para = 
						"-32767","3400","-1","820","0",
						"3400","32767","-1","-1","0";
			segment_para = 
						"-32767","4150","3900","4208","50",
						"4150","4450","2730","4400","0";
			batt_brand = "scudguangyu";
			fcc_temp = <3939 3934 3923 3941 3903 3877>;
			fcc_sf_x = <0 100 200 300 400 500>;
			fcc_sf_y = <100 96 94 92 90 88>;
			fcc_sf_cols = <6>;
			pc_sf_rows = <1>;
			pc_sf_cols = <1>;
			pc_sf_row_entries = <0>;
			pc_sf_percent = <100>;
			pc_sf_sf = <100>;
			rbatt_sf_rows = <28>;
			rbatt_sf_cols = <6>;
			rbatt_sf_percent = <100 95 90 85 80 75 70 65 60 55 50 45 40 35 30 25 20 15 10 9 8 7 6 5 4 3 2 1>;
			rbatt_sf_sf = <
			               1904 1174 564 117 73 59
			               1885 1170 565 117 73 59
			               1785 1134 567 117 74 59
			               1712 1079 567 119 75 61
			               1641 1114 585 122 77 62
			               1442 1043 590 127 79 64
			               1410 909 499 136 83 66
			               1379 896 491 147 91 69
			               1379 871 473 141 96 74
			               1410 864 446 116 86 70
			               1475 901 439 105 72 60
			               1570 973 461 106 72 61
			               1684 1080 518 108 75 63
			               1797 1205 612 109 80 66
			               1892 1317 738 110 79 66
			               1973 1395 872 111 72 60
			               2058 1454 995 117 72 60
			               2173 1522 1116 129 73 60
			               3564 1631 864 117 78 63
			               3812 1779 964 122 74 62
			               4054 1951 1075 126 74 60
			               4327 2098 1160 132 76 62
			               4614 2308 1318 137 75 63
			               4900 2469 1444 134 74 61
			               5231 2665 1546 150 76 63
			               5647 2873 1665 165 80 65
			               6178 3179 1938 258 83 64
			               6924 3723 2338 906 103 80
			              >;
			pc_temp_ocv_rows = <29>;
			pc_temp_ocv_cols = <6>;
			pc_temp_ocv_percent = <100 95 90 85 80 75 70 65 60 55 50 45 40 35 30 25 20 15 10 9 8 7 6 5 4 3 2 1>;
			pc_temp_ocv_ocv = <
			                   4355 4353 4350 4347 4337 4334
			                   4227 4248 4262 4275 4267 4265
			                   4158 4178 4199 4217 4209 4207
			                   4109 4114 4144 4162 4154 4153
			                   4063 4087 4094 4109 4101 4100
			                   3967 4032 4046 4058 4050 4050
			                   3922 3949 3973 4006 4003 4005
			                   3875 3906 3930 3964 3965 3964
			                   3843 3863 3888 3923 3924 3924
			                   3823 3829 3847 3876 3878 3880
			                   3810 3812 3816 3842 3842 3842
			                   3800 3801 3800 3818 3819 3819
			                   3787 3792 3791 3799 3801 3800
			                   3774 3782 3782 3784 3786 3785
			                   3760 3770 3772 3772 3771 3767
			                   3745 3756 3759 3758 3751 3740
			                   3731 3740 3742 3739 3731 3719
			                   3712 3722 3721 3710 3705 3695
			                   3687 3701 3693 3689 3682 3671
			                   3680 3695 3688 3687 3681 3670
			                   3672 3691 3684 3685 3680 3669
			                   3663 3685 3678 3682 3677 3667
			                   3651 3678 3671 3674 3672 3661
			                   3634 3663 3657 3648 3656 3645
			                   3607 3636 3633 3603 3619 3610
			                   3567 3590 3589 3543 3567 3562
			                   3507 3521 3523 3466 3498 3496
			                   3407 3417 3426 3386 3395 3399
			                   3200 3200 3200 3200 3200 3200
			                  >;
		};
};
