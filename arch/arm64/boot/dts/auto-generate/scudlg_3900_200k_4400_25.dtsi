/* DO NOT EDIT - Automatically generated by python */
/ {
		scudlg_3900_200k_4400_25:scudlg_3900_200k_4400_25 {
			fcc = <3900>;
			default_rbatt_mohm = <100>;
			id_identify_min = <2786>;
			id_identify_max = <3312>;
			id_voltage_min = <2941>;
			id_voltage_max = <3167>;
			vbat_max = <4400>;
			temp_para = 
						"-32767","0","-1","0","4100","0",
						"0","5","-1","390","4400","0",
						"5","10","-1","1170","4400","3",
						"10","45","-1","-1","4400","3",
						"45","50","-1","1365","4400","3",
						"50","32767","-1","0","4400","0";
			vbat_para = 
						"-32767","3400","-1","820","0",
						"3400","32767","-1","-1","0";
			segment_para = 
						"-32767","4150","3900","4208","50",
						"4150","4450","2730","4400","0";
			batt_brand = "scudlg";
			fcc_temp = <3989 3983 3975 3985 3970 3947>;
			fcc_sf_x = <0 100 200 300 400 500>;
			fcc_sf_y = <100 96 94 92 90 88>;
			fcc_sf_cols = <6>;
			pc_sf_rows = <1>;
			pc_sf_cols = <1>;
			pc_sf_row_entries = <0>;
			pc_sf_percent = <100>;
			pc_sf_sf = <100>;
			rbatt_sf_rows = <28>;
			rbatt_sf_cols = <6>;
			rbatt_sf_percent = <100 95 90 85 80 75 70 65 60 55 50 45 40 35 30 25 20 15 10 9 8 7 6 5 4 3 2 1>;
			rbatt_sf_sf = <
			               1494 575 278 104 86 80
			               1468 576 280 104 86 80
			               1372 572 285 106 86 81
			               1277 571 292 108 88 81
			               1206 593 304 112 90 82
			               1106 586 326 120 93 84
			               1034 542 315 130 98 86
			               1034 520 288 142 107 91
			               1036 516 274 129 107 94
			               1041 512 261 108 93 87
			               1063 518 258 102 86 81
			               1098 532 261 103 85 81
			               1144 556 265 106 88 82
			               1210 592 274 108 92 85
			               1299 641 288 108 90 83
			               1418 713 307 104 86 81
			               1571 823 332 104 86 84
			               1781 1053 374 106 87 84
			               2416 980 347 104 85 81
			               2761 1068 359 106 87 83
			               3176 1217 381 108 89 85
			               3648 1382 415 110 90 87
			               4226 1644 461 111 90 86
			               4930 1972 518 112 88 83
			               5729 2389 574 123 85 83
			               6539 2999 672 217 105 99
			               7427 3881 731 282 174 113
			               8174 4752 949 306 155 103
			              >;
			pc_temp_ocv_rows = <29>;
			pc_temp_ocv_cols = <6>;
			pc_temp_ocv_percent = <100 95 90 85 80 75 70 65 60 55 50 45 40 35 30 25 20 15 10 9 8 7 6 5 4 3 2 1>;
			pc_temp_ocv_ocv = <
			                   4361 4360 4357 4351 4344 4338
			                   4279 4289 4290 4290 4284 4279
			                   4214 4226 4231 4231 4226 4221
			                   4157 4168 4174 4174 4169 4164
			                   4105 4121 4122 4119 4114 4110
			                   4030 4061 4071 4070 4063 4059
			                   3953 3984 4005 4017 4015 4011
			                   3912 3932 3948 3970 3971 3968
			                   3876 3895 3908 3922 3923 3922
			                   3843 3859 3870 3876 3877 3877
			                   3819 3829 3839 3844 3844 3843
			                   3802 3807 3815 3821 3820 3818
			                   3790 3792 3796 3802 3801 3799
			                   3778 3782 3783 3786 3786 3784
			                   3767 3773 3775 3772 3768 3762
			                   3754 3761 3765 3756 3748 3738
			                   3741 3744 3749 3739 3730 3718
			                   3725 3724 3723 3712 3703 3691
			                   3700 3701 3699 3689 3681 3670
			                   3693 3697 3697 3688 3680 3669
			                   3687 3693 3694 3686 3679 3668
			                   3678 3688 3692 3684 3676 3665
			                   3664 3681 3688 3677 3672 3660
			                   3643 3666 3677 3657 3656 3641
			                   3613 3636 3646 3617 3618 3605
			                   3569 3588 3599 3568 3567 3556
			                   3516 3526 3530 3505 3503 3490
			                   3418 3421 3423 3404 3401 3391
			                   3200 3200 3200 3200 3200 3200
			                  >;
		};
};
