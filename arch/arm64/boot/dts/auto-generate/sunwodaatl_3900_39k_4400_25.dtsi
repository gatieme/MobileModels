/* DO NOT EDIT - Automatically generated by python */
/ {
		sunwodaatl_3900_39k_4400_25:sunwodaatl_3900_39k_4400_25 {
			fcc = <3900>;
			default_rbatt_mohm = <100>;
			id_identify_min = <1235>;
			id_identify_max = <1759>;
			id_voltage_min = <1420>;
			id_voltage_max = <1562>;
			vbat_max = <4400>;
			temp_para = 
						"-32767","0","-1","0","4100","0",
						"0","5","-1","390","4400","0",
						"5","10","-1","1170","4400","3",
						"10","45","-1","-1","4400","3",
						"45","50","-1","1365","4400","3",
						"50","32767","-1","0","4400","0";
			vbat_para = 
						"-32767","3400","-1","820","0",
						"3400","32767","-1","-1","0";
			segment_para = 
						"-32767","4150","3900","4208","50",
						"4150","4450","2730","4400","0";
			batt_brand = "sunwodaatl";
			fcc_temp = <3775 3854 3848 3879 3863 3835>;
			fcc_sf_x = <0 100 200 300 400 500>;
			fcc_sf_y = <100 96 94 92 90 88>;
			fcc_sf_cols = <6>;
			pc_sf_rows = <1>;
			pc_sf_cols = <1>;
			pc_sf_row_entries = <0>;
			pc_sf_percent = <100>;
			pc_sf_sf = <100>;
			rbatt_sf_rows = <28>;
			rbatt_sf_cols = <6>;
			rbatt_sf_percent = <100 95 90 85 80 75 70 65 60 55 50 45 40 35 30 25 20 15 10 9 8 7 6 5 4 3 2 1>;
			rbatt_sf_sf = <
			               1749 1028 422 117 92 84
			               1649 1022 421 117 93 84
			               1523 986 420 118 93 85
			               1433 945 416 119 95 86
			               1347 944 420 122 96 87
			               1247 903 440 127 99 90
			               1198 821 430 136 103 91
			               1189 794 396 148 111 96
			               1183 781 381 141 111 97
			               1190 769 366 116 96 87
			               1216 779 364 112 92 86
			               1255 808 369 113 93 86
			               1302 850 386 116 95 87
			               1360 902 415 119 99 91
			               1431 968 454 120 99 92
			               1513 1047 503 116 93 86
			               1615 1141 568 114 91 86
			               1757 1246 660 116 92 87
			               2417 1106 600 116 93 88
			               2726 1217 575 117 94 89
			               3054 1356 624 118 95 90
			               3421 1541 694 121 94 91
			               3833 1735 770 123 96 89
			               4300 1996 882 122 94 88
			               4830 2227 987 123 94 88
			               5505 2580 1120 133 94 89
			               6400 3117 1383 145 98 91
			               7747 4001 1907 255 108 93
			              >;
			pc_temp_ocv_rows = <29>;
			pc_temp_ocv_cols = <6>;
			pc_temp_ocv_percent = <100 95 90 85 80 75 70 65 60 55 50 45 40 35 30 25 20 15 10 9 8 7 6 5 4 3 2 1>;
			pc_temp_ocv_ocv = <
			                   4312 4343 4350 4355 4349 4342
			                   4241 4282 4290 4298 4292 4286
			                   4185 4220 4233 4241 4235 4229
			                   4135 4161 4177 4184 4179 4174
			                   4079 4118 4124 4129 4124 4120
			                   4006 4063 4076 4078 4073 4069
			                   3947 3988 4016 4029 4025 4022
			                   3907 3936 3956 3981 3980 3978
			                   3870 3896 3914 3933 3933 3932
			                   3840 3857 3873 3883 3884 3882
			                   3819 3828 3840 3851 3851 3850
			                   3803 3810 3815 3827 3827 3826
			                   3790 3797 3797 3807 3808 3806
			                   3778 3786 3786 3790 3791 3789
			                   3765 3776 3777 3774 3773 3769
			                   3751 3763 3766 3757 3750 3740
			                   3737 3746 3749 3736 3729 3718
			                   3720 3722 3722 3711 3705 3694
			                   3697 3699 3694 3689 3682 3672
			                   3689 3694 3690 3688 3681 3671
			                   3681 3690 3687 3686 3680 3669
			                   3670 3685 3682 3683 3677 3666
			                   3657 3676 3675 3675 3672 3661
			                   3637 3661 3660 3651 3654 3640
			                   3607 3630 3630 3608 3617 3603
			                   3563 3582 3580 3550 3566 3554
			                   3498 3513 3510 3472 3497 3487
			                   3400 3409 3408 3353 3396 3390
			                   3200 3200 3200 3200 3200 3200
			                  >;
		};
};
