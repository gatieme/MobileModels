## common/drivers/blackbox/Kconfig
```kconfig
# SPDX-License-Identifier: GPL-2.0
menu "Blackbox Options"

config BLACKBOX
	bool "Support for blackbox"
	default y
	help
		The blackbox is a fault log collecting framework for registered modules
		of chips. When a fault occurs, blackbox will invoke the registered
		function to save the log and reset the module.

config BLACKBOX_LOG_ROOT_PATH
	string "root path of the blackbox log"
	depends on BLACKBOX
	help
		define the root path of the blackbox log

config BLACKBOX_LOG_PART_REPRESENTATIVE
	string "representative of the blackbox log part"
	depends on BLACKBOX
	help
		define the representative of the blackbox log part

config BLACKBOX_EXPAND_EVENT
	bool "Support expand event"
	depends on BLACKBOX
	help
		define the expand event info for blackbox

if BLACKBOX

source "drivers/blackbox/platform/Kconfig"

endif

endmenu
```

## common/drivers/card_tray/card_tray_detect/Kconfig
```kconfig
menuconfig CARD_TRAY_GPIO_DETECT
    tristate "card_tray_gpio_detect support"
    default n
```

## common/drivers/dp/Kconfig
```kconfig
config HUAWEI_DP_AUX
	tristate "huawei dp aux driver"
	help
	  Enable this option to enable the dp aux
```

## common/drivers/huawei_platform/hwpower/glink/Kconfig
```kconfig
# SPDX-License-Identifier: GPL-2.0
config HUAWEI_POWER_GLINK
	tristate "huawei power glink"
	depends on QTI_PMIC_GLINK
	default n
	help
	  Say Y here to enable power glink driver.
	  Say M here to compile the driver as a module.

config HUAWEI_POWER_GLINK_INTERFACE
	bool "huawei power glink interface"
	default n
	help
	  Say Y here to enable power glink interface driver.
```

## common/drivers/huawei_platform/usb/Kconfig
```kconfig
source "drivers/huawei_platform/usb/pd/Kconfig"
source "drivers/huawei_platform/usb/switch/Kconfig"
source "drivers/huawei_platform/usb/ulog_trace/Kconfig"
source "drivers/huawei_platform/usb/cust_attr/Kconfig"
source "drivers/huawei_platform/usb/function-huawei/Kconfig"
source "drivers/huawei_platform/usb/usb_extra_modem/Kconfig"
source "drivers/huawei_platform/usb/hw_pogopin/Kconfig"
source "drivers/huawei_platform/usb/misc/Kconfig"
```

## common/drivers/huawei_platform/usb/misc/Kconfig
```kconfig
config HWUSB_MISC
	bool "huawei usb misc driver"
	default n
	help
	  Enable this option to support extra modem by usb.
```

## common/drivers/huawei_platform/usb/ulog_trace/Kconfig
```kconfig
config ULOG_TRACE
	tristate "huawei ulog trace driver"
	default n
	help
	  Enable this option to trace adsp log.
```

## common/drivers/power/charger/Kconfig
```kconfig
config HUAWEI_DSM
	bool "huawei power dsm"

config HUAWEI_BATT
	bool "huawei batt"

config HUAWEI_BUCK_CHARGER
        bool "huawei buck charger"
        default n
```

## common/drivers/rainbow_trace/Kconfig
```kconfig
# SPDX-License-Identifier: GPL-2.0
config DFX_RAINBOW_TRACE
	tristate "Support for trace record"
	depends on BLACKBOX && QCOM_MINIDUMP
	help
	  rainbow trace will record irq and schedule trace log.
```

## common/drivers/rsmc/Kconfig
```kconfig
config HW_RSMC
	tristate "kernel space communicate with user space use netlink socket."
    default n
    help
	  BeiDou short packet kernel driver, used to adapt to the short packet chip.
```

## common/drivers/staging/android/Kconfig
```kconfig
# SPDX-License-Identifier: GPL-2.0
menu "Android"

if ANDROID

config ASHMEM
	bool "Enable the Anonymous Shared Memory Subsystem"
	depends on SHMEM
	help
	  The ashmem subsystem is a new shared memory allocator, similar to
	  POSIX SHM but with different behavior and sporting a simpler
	  file-based API.

	  It is, in theory, a good memory allocator for low-memory devices,
	  because it can discard shared memory units when under memory pressure.

config DEBUG_KINFO
	bool "Debug Kernel Information Support"
	depends on KALLSYMS
	help
	  This supports kernel information backup for bootloader usage.
	  Specifics:
	   - The kallsyms symbols for unwind_backtrace
	   - Page directory pointer
	   - UTS_RELEASE
	   - BUILD_INFO(ro.build.fingerprint)

config HUAWEI_RCC
	tristate "RAM Compress and Clean"
	depends on SYSFS && SWAP
	default n
	help
	  Creates background thread for compress and clean used RAM
	  dynamiclly,enabled by write 1 to /sys/kernel/rcc/enable.

config HUAWEI_RCC_DEBUG
	bool "RAM Compress and Clean debug support"
	depends on HUAWEI_RCC
	default n
	help
	  This option adds additional debugging code to the
	  RAM Compress and Clean module.

source "drivers/staging/android/ion/Kconfig"

source "drivers/staging/android/hwlogger/Kconfig"

endif # if ANDROID

endmenu
```

## common/drivers/vibrator/Kconfig
```kconfig
config HUAWEI_VIBRATOR
	tristate "huawei vibrator driver"
	default y
	help
		If you yes here to support the huawei vibrator driver.

config HUAWEI_PMI_LDO_VIBRATOR
	tristate "huawei pmi ldo vibrator driver"
	default y
	help
		If you yes here to support the pmi vibrator driver.
```

## common/kernel/sched/hw_walt/Kconfig
```kconfig
#
# Huawei enhanced options for sched walt
#

if SCHED_WALT

config HW_SCHED_PRED_LOAD
	bool "Calculate predicted load for each task"
	default n
	depends on SCHED_WALT
	help
	  Another signal to improve schedutil. This will help to ramp up
	  cpufreq quickly.
	  To enable this signal, say yes here and set predl_enable to 1
	  in init rc.

config HW_SCHED_PRED_LOAD_WINDOW_SIZE_TUNNABLE
	bool "Calculate predicted load using tunable window size"
	default n
	depends on HW_SCHED_PRED_LOAD
	help
	  Some platforms has original predicted load calculation, which
	  has non-tunnable window size. This option is to make up for
	  this feature.

config  HW_SCHED_PRED_LOAD_WINDOW_SIZE_SYNC
	bool "keep predicted load window size synchronized"
	default n
	depends on HW_SCHED_PRED_LOAD_WINDOW_SIZE_TUNNABLE
	help
	  When predicted load window size tunnable, keep it synchronized

config HW_SCHED_CHECK_IRQLOAD
	bool "Scheduler check irqload when select task's cpu"
	default n
	help
	  WALT caculates an irqload for each cpu and scheduler will avoid
	  placing task on a high irqload cpu (if WALT enabled).

config HW_SCHED_WALT
	bool "WALT platform functions"
	default n
	depends on SCHED_WALT
	select HAVE_QCOM_SCHED_WALT if ARCH_QCOM
	help
	  WALT platform functions

config HAVE_QCOM_SCHED_WALT
	bool "QCOM WALT features"
	default n
	help
	  This option used to identify platform difference

config HW_SCHED_WALT_DEBUG
	bool "Debug HW WALT features"
	depends on HW_SCHED_WALT
	default n
	help
	  This option used to debug walt features

endif # SCHED_WALT
```

## common/mm/lmkd_dbg_trigger/Kconfig
```kconfig
# SPDX-License-Identifier: GPL-2.0
config ANDROID_LOW_MEMORY_KILLER
	bool "Android Low Memory Killer"
	help
	  Registers processes to be killed when low memory conditions, this is useful
	  as there is no particular swap space on android.
	  The registered process will kill according to the priorities in android init
	  scripts (/init.rc), and it defines priority values with minimum free memory size
	  for each priority.

config HUAWEI_LMK_DBG
	bool "HUAWEI Low Memory Killer debug"
	default n
	depends on ANDROID_LOW_MEMORY_KILLER
	help
	  print processes info when lmk happen per several seconds

config HW_LOWMEM_DBG
	bool "enable lmkd_dbg_trigger"
	default n
```

## common/mm/mm_debug/Kconfig
```kconfig
# SPDX-License-Identifier: GPL-2.0
config HUAWEI_SLOW_PATH_COUNT
	bool "page alloc enter slow path count"
	default n
	help
	  Say 'Y' here is you want to count page alloc slow path.
```

## drivers/block/zram/hyperhold/Kconfig
```kconfig
# SPDX-License-Identifier: GPL-2.0
# Hyperhold container backend device configuration

# Selected when system need hyperhold container
config HYPERHOLD_CORE
	bool "Hyperhold container device support"
#	depends on ZRAM && HYPERHOLD && ZS_MALLOC_EXT
    depends on HYPERHOLD && ZS_MALLOC_EXT
	default n
	help
	  Say Y here if you want to use the hyperhold
	  as the backend device in ZRAM.
	  If unsure, say N here.
	  This module can't be compiled as a module,
	  the module is as one part of the ZRAM driver.

config HYPERHOLD_DEBUG_FS
	bool "Hyperhold debug fs proc"
	depends on HYPERHOLD
	default n
	help
	  Say Y here if you want to use debug proc of
	  hyperhold

config MAS_BLK
	bool "Hyperhold block"
	depends on HYPERHOLD
	default n
	help
	  Say Y here if you want to use interfaces
	  provided by the storage

config HYPERHOLD_UFS
	bool "hyperhold ufs health query"
	depends on HYPERHOLD_CORE && !MAS_BLK
	default n
	help
	  Say Y here if MAS_BLK not implemnted.
config HYPERHOLD_GKI
	bool "hyperhold gki"
	default n
	help
	  This feature supports hyperhold gki
config HYPERHOLD_GKI_DEBUG
	bool "hyperhold gki debug"
	depends on HYPERHOLD_GKI
	default n
	help
	  This feature supports hyperhold gki debug
config ZSWAPD_GKI
	bool "hyperhold gki zswapd"
	default n
	help
	  This feature supports hyperhold gki zswapd

config RECLAIM_OPT
        bool "To optimize the reclaim"
        default n
        help
	  To optimize the reclaim.set reclaim thread cpus_allowed.
```

## drivers/bootfail/Kconfig
```kconfig
#
# honor device state monitor configuration
#

config BOOT_DETECTOR
	tristate "boot detector"
	default n
	select BOOT_RECOVERY
	select BOOT_DETECTOR_GKI if BOOT_DETECTOR=m
	help
	  If you say yes here you get support for honor Boot Detector solution.

config BOOT_DETECTOR_GKI
	bool "Boot Detector for GKI"
	depends on BOOT_DETECTOR
	default n

config BOOT_DETECTOR_QCOM
	bool "Boot Detector for qcom"
	depends on BOOT_DETECTOR
	default n
	help
	  If you say yes here you get support for honor Boot Detector solution on qcom.

config BOOT_DETECTOR_MTK
	bool "Boot Detector for mtk"
	depends on BOOT_DETECTOR
	default n
	help
	  If you say yes here you get support for honor Boot Detector solution on mtk.

config BOOT_DETECTOR_MSTAR
	bool "Boot Detector for mstar"
	depends on BOOT_DETECTOR
	default n
	help
	  If you say yes here you get support for honor Boot Detector solution on mstar.

config BOOT_DETECTOR_SPRD
	bool "Boot Detector for sprd"
	depends on BOOT_DETECTOR
	default n
	help
	  If you say yes here you get support for honor Boot Detector solution on mtk-4g.

config BOOT_RECOVERY
	bool "use Boot Recovery"
	depends on BOOT_DETECTOR
	default n
	help
	  If you say yes here you get support for honor Boot Recovery solution
```

## drivers/boottime/Kconfig
```kconfig
config BOOT_TIME
	tristate "Boot Time Recoder"
	default n
	help
	  A driver to record boot time.
```

## drivers/cfi/Kconfig
```kconfig
#
# CFI configuration
#

config HONOR_CFI_TAG
	hex "honor cfi tag"
	default "0x0035c000"
	depends on HONOR_CFI_DEBUG
	help
	  It configs the 4-byte value used to tag function entry.
	  Note, for ARM architecture, not all integer constants can be encoded in one instruction.
	  Refer to "Flexible second operand" in ARM Instruction Reference for more info.

config HONOR_CFI
	bool "HONOR CFI support"
	default n
	help
	  Say yes here to support the HONOR CFI feature
	  which adds a word to the head of a function and checks the word when jump to the function,to
	  avoid jop attack.
	  If you are unsure, say N.

config HONOR_CFI_DEBUG
	bool "HONOR CFI test support"
	default n
	help
	  Say yes here to support the HONOR CFI debug
	  debugfs is /proc/.
	  which give a debugfs to simulate jop attack.
	  If you are unsure, say N.

config HONOR_CFI_POINTER_INFO
	bool "HONOR CFI POINTER INFO support"
	default n
	help
	  The same config as CFI_PERMISSIVE for report.
```

## drivers/common/Kconfig
```kconfig
menuconfig DRIVER_BRIGE
	tristate "driver brige"
	default n
	help
	  If you say yes here you get support for driver brige.
```

## drivers/cpufreq/Kconfig.honor
```kconfig
config CPU_FREQ_POWER_STAT
 bool "Estimation of task power consumption"
 depends on CPU_FREQ_STAT
 select CPU_FREQ_TIMES
 default n
 help
   Keep track of amount of power each task consumes and report power per uid
```

## drivers/devkit/audiokit/Kconfig
```kconfig
#
# Audiokit configuration
#
config AUDIOKIT
bool "Audio Kit"
default n
help
 choose y to open Audio Kit
source "drivers/audiokit/adsp_chr/Kconfig"
if AUDIOKIT
source "drivers/audiokit/dsm_audio/Kconfig"
source "drivers/audiokit/boxid/Kconfig"
source "drivers/audiokit/smartpakit/Kconfig"
source "drivers/audiokit/ana_hs_kit/Kconfig"
source "drivers/audiokit/adsp_misc/Kconfig"
endif
```

## drivers/devkit/audiokit/adsp_misc/Kconfig
```kconfig
config HONOR_ADSP_MISC
    tristate "audio dsp driver for ipi adapter"
    default n

config ADSP_HONOR_SHARED_MEM
    tristate "mtk shared mem between ap and adsp for honor params"
    depends on HONOR_ADSP_MISC
    default n
```

## drivers/devkit/audiokit/boxid/Kconfig
```kconfig
config HONOR_DEVICEBOX_AUDIO
	tristate "device boxid driver"
	default n
	help
		Say Y to enable device boxid driver support

config AUDIO_BOXID_USE_ADC
	tristate "device boxid driver to support adc"
	default n
	help
		Say Y to enable device boxid driver to support adc
```

## drivers/devkit/audiokit/dsm_audio/Kconfig
```kconfig
###################################################
#                                                 #
# honor device state monitor audio configuration #
#                                                 #
###################################################

config HONOR_DSM_AUDIO
	tristate "honor dsm audio"
	default n
#	depends on DSM
	help
	  If you say yes here you get support for honor dsm audio.
```
