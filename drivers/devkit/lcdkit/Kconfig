## drivers/devkit/lcdkit/Kconfig
```kconfig
#
# lcdkit driver configuration
#
source "drivers/devkit/lcdkit/lcdkit3.0/Kconfig"
source "drivers/devkit/lcdkit/qcomkit/Kconfig"
```

## drivers/devkit/lcdkit/lcdkit3.0/kernel/common/src/Kconfig
```kconfig
#
# lcdkit common configuration
#

menuconfig LCD_KIT_COMMON
	tristate "lcd kit 3.0 common"
	default y
	help
	   If you say yes here you get support for lcd kit common.
```

## drivers/devkit/lcdkit/lcdkit3.0/kernel/mtk/adapt/Kconfig
```kconfig
#
# lcdkit mtk driver configuration
#

menuconfig LCD_KIT_MTK
	tristate "lcd kit 3.0 mtk driver"
	default y
	help
	   If you say yes here you get support for lcd kit mtk driver.
```

## drivers/devkit/lcdkit/lcdkit3.0/kernel/sprd/src/Kconfig
```kconfig
#
# lcdkit sprd driver configuration
#
menuconfig LCD_KIT_SPRD
	bool "lcd kit 3.0 sprd driver"
	default n
	help
	   If you say yes here you get support for lcd kit sprd driver.
```

## drivers/devkit/lcdkit/qcomkit/Kconfig
```kconfig
#
# lcdkit qcom driver configuration
#

menuconfig LCD_QCOM_DRV
	bool "qcom lcd kit  driver"
	default n
	help
	    If you say yes here you get support for lcd kit driver.

menuconfig LCD_FACTORY
        bool "qcom lcd factory test"
        default n
        help
            If you say yes here you get support for lcd factory test.
```

## drivers/devkit/tpkit/3_0/Kconfig
```kconfig
#
# honor touchscreen driver configuration
#

menuconfig HONOR_HOST_TS_KIT_3_0
	tristate "honor HOST_TS_KIT 3.0 touchscreen"
	default n
	help
	  If you say yes here you get support for hostprocessing touchscreen.
menuconfig HONOR_TS_KIT_3_0
	tristate "honor TS_KIT 3.0 drivers"
	default n
	help
	  If you say yes here you get support for honor touchscreen.
menuconfig HONOR_TS_KIT_TEST_3_0
	bool "honor TS_KIT 3.0 test"
	default n
	help
	  If you say yes here you get support for honor touchscreen.
menuconfig HONOR_TS_KIT_COMMON_3_0
	bool "honor TS_KIT 3.0 common"
	default n
	help
	  If you say yes here you get support for honor touchscreen.
menuconfig HONOR_DEVKIT_QCOM_3_0
	tristate "honor CONFIG_DEVKIT_QCOM 3.0"
	default n
	help
	  If you say yes here you get support for honor touchscreen.
menuconfig HONOR_DEVKIT_MTK_3_0
	tristate "honor CONFIG_DEVKIT_MTK 3.0"
	default n
	help
	  If you say yes here you get support for honor touchscreen.
menuconfig HONOR_TS_CAP
	tristate "honor CONFIG_HONOR_TS_CAP 3.0"
	default n
	help
	  If you say yes here you get support for honor touchscreen.

#sensor unification for differ platform
menuconfig HONOR_TP_KIT_COLOR_INFO_3_0
	tristate "honor TS_KIT 3.0 tp color info"
	default n
	help
		get the honor TS_KIT tp color information.
```

## drivers/devkit/tpkit/3_0/panel/atmel/Kconfig
```kconfig
#
# honor touchscreen driver configuration
#

menuconfig ATMEL_TS_KIT_3_0
	tristate "honor  ts kit atmel 3.0 drivers"
	default n
	help
	  If you say yes here you get support for honor touchscreen.
```

## drivers/devkit/tpkit/3_0/panel/elan/Kconfig
```kconfig
#
# honor touchscreen driver configuration
#
menuconfig ELAN_TS_KIT_3_0
	bool "honor TS_KIT elan 3.0 drivers"
	default n
	help
	  If you say yes here you get support for honor touchscreen.
```

## drivers/devkit/tpkit/3_0/panel/himax_64/Kconfig
```kconfig
#
# honor touchscreen driver configuration
#

menuconfig HIMAX_TS_KIT_3_0
	bool "honor ts kit himax_64 drivers"
	default n
	help
	  If you say yes here you get support for honor touchscreen.
```

## drivers/devkit/tpkit/3_0/panel/parade/Kconfig
```kconfig
#
# honor touchscreen driver configuration
#
menuconfig PARADE_TS_KIT_3_0
	tristate "honor  ts kit 3.0 parade drivers"
	default n
	help
	  If you say yes here you get support for honor touchscreen.
```

## drivers/devkit/tpkit/Kconfig
```kconfig
#
# honor touchscreen driver configuration
#

menuconfig HONOR_HOST_TS_KIT
	tristate "honor HOST_TS_KIT touchscreen"
	default n
	help
	  If you say yes here you get support for hostprocessing touchscreen.
menuconfig HONOR_TS_KIT_TEST
	bool "honor TS_KIT test"
	default n
	help
	  If you say yes here you get support for honor touchscreen.
menuconfig HONOR_TS_KIT_COMMON
	bool "honor TS_KIT common"
	default n
	help
	  If you say yes here you get support for honor touchscreen.
menuconfig HONOR_DEVKIT_HONOR
	tristate "honor CONFIG_DEVKIT_HONOR"
	default n
	help
	  If you say yes here you get support for honor touchscreen.
menuconfig HONOR_DEVKIT_QCOM
	tristate "honor CONFIG_DEVKIT_QCOM"
	default n
	help
	  If you say yes here you get support for honor touchscreen.

menuconfig HONOR_THP_QCOM
	tristate "honor CONFIG_THP_QCOM"
	default n
	help
	  If you say yes here you get support for honor touchscreen.

menuconfig HONOR_THP_MTK
	tristate "honor CONFIG_THP_MTK"
	default n
	help
	  If you say yes here you get support for honor touchscreen.

menuconfig TP_QCOM_8450
	tristate "honor TP_QCOM_8450"
	default n
	help
	  If you say yes here you get support for honor touchscreen.

menuconfig TP_QCOM_8550
	tristate "honor TP_QCOM_8550"
	default n
	help
	If you say yes here you get support for honor touchscreen.

menuconfig TPKIT
	tristate "honor TPKIT"
	default n
	help
		If you say yes here you get support for honor touchscreen.

source "drivers/devkit/tpkit/hostprocessing/Kconfig"
source "drivers/devkit/tpkit/3_0/Kconfig"

#sensor unification for differ platform
menuconfig HONOR_TP_KIT_COLOR_INFO
	tristate "honor TS_KIT tp color info"
	default n
	help
		get the honor TS_KIT tp color information.
```

## drivers/emcom/Kconfig
```kconfig
menuconfig HONOR_EMCOM
    bool "Honor emcom feature support"
    default n
    help
    Say yes here to support emcom feature

if HONOR_EMCOM
source "drivers/emcom/argo/Kconfig"
source "drivers/emcom/xengine/Kconfig"
source "drivers/emcom/smartcare/Kconfig"
source "drivers/emcom/nweval/Kconfig"
source "drivers/emcom/opmp/Kconfig"
source "drivers/emcom/nstack/Kconfig"
endif # if HONOR_EMCOM
```

## drivers/emcom/nstack/Kconfig
```kconfig
menuconfig HN_EMCOM_NSTACK
	bool "Honor Emcom Nstack"
	depends on HONOR_EMCOM
	default n

if HN_EMCOM_NSTACK
source "drivers/emcom/nstack/fi/Kconfig"
endif # if HN_EMCOM_NSTACK
```

## drivers/emcom/nstack/fi/Kconfig
```kconfig
config HN_NSTACK_FI
	bool "Honor NSTACK FI"
	depends on HN_EMCOM_NSTACK
	default n
```

## drivers/emcom/smartcare/Kconfig
```kconfig
menuconfig HN_NETWORK_MEASUREMENT
	bool "Honor Network Measurement System"
	depends on HONOR_EMCOM
	default n

if HN_NETWORK_MEASUREMENT
source "drivers/emcom/smartcare/fi/Kconfig"
endif # if HN_NETWORK_MEASUREMENT
```

## drivers/emcom/smartcare/fi/Kconfig
```kconfig
config HN_SMARTCARE_FI
	bool "Honor Smartcare FI"
	depends on HN_NETWORK_MEASUREMENT
	default n
```

## drivers/emcom/xengine/Kconfig
```kconfig
config HONOR_XENGINE
	bool "Honor xengine feature support"
	default n

config HONOR_EMCOM_CHANNEL
	bool "Honor emcom channel feature support"
	default n
```

## drivers/hitrace/Kconfig
```kconfig
#
# honor hitrace interface support in kernel
#

config HONOR_HITRACE
	tristate "honor HITRACE"
	default n
	help
	  This driver support for honor hitrace solution.

config HONOR_HITRACE_DEBUG
	tristate "honor HITRACE debug"
	default n
	help
	  It only used to test hitrace driver
```

## drivers/huawei_platform/hw_dynamic_sched/Kconfig
```kconfig
config HW_DYNAMIC_SCHED
	tristate "huawei dynamic sched"
	default n
	help
	  If you say yes here you get support for dynamic sched,
	  the prio of critical tasks will be dynamically adjusted
	  based on actual requirements.
```

## drivers/huawei_platform/mipibridge/Kconfig
```kconfig
#
# huawei mipibridge configuration
#

config HUAWEI_MIPIBRIDGE
	bool "huawei mipibridge"
	default n
	help
	  If you say yes here you get support for huawei mipibridge.
```

## drivers/hwmanufac/dev_detect/Kconfig
```kconfig
# detect devices

menuconfig HONOR_HW_DEV_DCT
    tristate  "HONOR DEVICE DETECT"
    default n
    help
      Say yes if you want i2c device detect driver.
      This is for i2c connected version. If unsure, say N here.
```

## drivers/hwmemcheck/Kconfig
```kconfig
config HN_MEMCHECK
	bool "Honor memory checker driver"
	default n
	help
	  This feature support to memory leak check
```

## drivers/hwnet/ipv4/Kconfig
```kconfig
config HN_WIFIPRO
	bool "Honor wifipro tcp monitor support"
	default n

config HN_WIFIPRO_PROC
	bool "Honor wifipro proc support"
	depends on HN_WIFIPRO
	default n

config WIFI_DELAY_STATISTIC
	bool "wifi delay statistic"
	default n

config HW_SNIFFER
	bool "hw sniffer"
	default n

config HN_CHR_TCP_SMALL_WIN_PROC
	bool "Honor tcp small window monitor proc support"
	depends on HN_CHR_TCP_SMALL_WIN_MONITOR
	default n

config HN_WIFI_TEMP
	bool "Honor wifi temperature upload"
	default n

config HONOR_MSS_AUTO_CHANGE
	bool "Honor MSS auto change undecoupled function support"
	default n
```
