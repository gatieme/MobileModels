## drivers/hwpower/cc_hardware_ic/boost_ic/Kconfig
```kconfig
# SPDX-License-Identifier: GPL-2.0
#
# huawei boost drivers
#

config BOOST_SC8726
	bool "boost sc8726"
	default n
	help
	  Say Y here to enable boost sc8726 driver.
```

## drivers/ioinfo/Kconfig
```kconfig
config PROC_IO_INFO
	tristate "/proc/ioinfo support"
	default n
	help
	  get IO information, include disk io stat, io top, io wait.
config HONOR_HOTFILE_DETECT
	bool "detect and protect hot files"
	depends on TRACING && MEMCG_PROTECT_LRU
	default n
	help
	  detect and protect hot files for system and top application
config HONOR_HOTFILE_DETECT_DEBUG
	bool "detect and protect hot files"
	depends on HONOR_HOTFILE_DETECT
	default n
	help
	  debug information for hot files detect
config HONOR_IO_INFO_DEBUG
	bool "for io info debug"
	default n
	help
	  debug io info incluing io_stat and pgcache_stat
```

## drivers/iomt_host/Kconfig
```kconfig
#
# honor mmc/ufs host device state stat config
#

config STORAGE_DSM_IOMT_HOST
	bool "dsm iomt host"
	default n
	help
	  enable host state stat feature.

config STORAGE_DSM_IOMT_EMMC_HOST
	bool "dsm iomt emmc host"
	depends on MMC != n && STORAGE_DSM_IOMT_HOST != n
	default n
	help
	  enable emmc host state stat feature.

config STORAGE_DSM_IOMT_UFS_HOST
	bool "dsm iomt ufs host"
	depends on SCSI != n && STORAGE_DSM_IOMT_HOST != n
	default n
	help
	  enable ufs host state stat feature.

config HONOR_IO_MEASURE
	bool "measure io performence"
	depends on TRACING
	default n
	help
	  enable io measure feature.
```

## drivers/log/Kconfig
```kconfig
#
# Logger configuration
#
menu "LOGGER support"

config LOGGER
	tristate "log driver"
	default n
	select LOG_EXCEPTION
	select LOG_JANK
	select LOG_KERNEL
	help
	  This adds support for system-wide logging using two log buffers.
	  Plus adds reboot watchdog for triggering logcat and xlogcat flush.
	  These are:
	      1: hwlog_exception, fault detection.
	      2: hwlog_jank,  performance detection.
	      3: hwlog_dubai, power detection.

config LOGGER_EXTEND
	bool "Logger extend support"
	depends on LOGGER
	default n
	help
	  Enable support for logger extend

config LOG_EXCEPTION
	bool "log exception feature support"
	depends on LOGGER
	default n
	help
	  Say Y here to enable log exception feature support. This allows
	  user to send log to remote server by net.

config LOG_JANK
	bool "log jank feature support"
	depends on LOGGER
	default n
	help
	  Say Y here to enable log jank feature support. This allows
	  user to send log to remote server by net.

config LOG_KERNEL
	bool "log feature support"
	depends on LOGGER
	default n
	help
	  Say Y here to enable log kernel feature support. This allows
	  user to send log to remote server by net.

config HIVIEW_SELINUX
	bool "hiview selinux support"
	depends on SECURITY && SECURITY_SELINUX
	default n
	help
	  Say Y here to enable log switch feature support. This allows
	  user to collect selinux log to hiview.

config LOGGER_LEGACY
	bool "logger legacy support"
	depends on LOGGER
	default n
	help
	  Say Y here to enable log operation with file.

source "drivers/log/module_test/Kconfig"

endmenu
```

## drivers/log/module_test/Kconfig
```kconfig
#
# Logger test configuration
#

config LOGGER_TEST
	tristate "logger test support"
	depends on LOGGER
	default n
	help
	  Say m here to enable logger module test,enable with rphone.
```

## drivers/micro_dump/Kconfig
```kconfig
config HN_MICRODUMP
	tristate "micro dump."
	default n

config HN_MICRODUMP_GKI
	bool "micro dump for gki"
	depends on HN_MICRODUMP
	default n

source "drivers/micro_dump/test/Kconfig"
```

## drivers/micro_dump/test/Kconfig
```kconfig
config HN_MICRODUMP_TEST
	tristate "micro dump."
	depends on HN_MICRODUMP
	default n
	help
	  micro_dump functional test ko
```

## drivers/mm_track/Kconfig
```kconfig
config HN_MM_TRACK
	bool "Honor memory tracker driver"
	default n
	help
	  This feature support to track kernel memory, including tracking slub
	  allocation and free, slub detail memory, vmalloc detail memory. More
	  fuctions to be continued.

source "drivers/mm_track/test_case/Kconfig"
```

## drivers/mm_track/test_case/Kconfig
```kconfig
config HN_MM_TRACK_KUNIT_TEST
	tristate "Kernel memory track test suite" if !KUNIT_ALL_TESTS
	default KUNIT_ALL_TESTS
	depends on KUNIT && HN_MM_TRACK
	help
	  Test suite for HN_MM_TRACK, testing custom slub allocation and free
	  track.
```

## drivers/net/bastet/Kconfig
```kconfig
#menu "Honor Bastet Support"
#	depends on INET && NETFILTER

config HONOR_BASTET_QCOM
	bool "Bastet QCOM data accelerate support"
	default n
	help
	  This driver provides QCOM platform data accelerate for Honor Bastet.
```

## drivers/perf_ctrl/Kconfig
```kconfig
menu "Honor Performace Control"

config HONOR_PERF_CTRL
	tristate "Honor Performance Control Drivers"
	default n
	help
	  Honor Performance Control Drivers

config HONOR_DDR_PERF_CTRL
	bool "ddr perf ctrl"
	depends on HONOR_PERF_CTRL
	default n

config HONOR_THERMAL_PERF_CTRL
	bool "thermal perf ctrl"
	depends on HONOR_PERF_CTRL
	default n

config RENDER_RT
	bool "render realted thread"
	default n
	help
	  Render Related Thread

config RENDER_RT_DEBUG
	bool "render realted thread test"
	depends on RENDER_RT
	depends on DEBUG_FS
	default n
	help
	  Render Related Thread debug trace

config SCHED_TASK_UTIL_CLAMP
	bool "Support userspace constraints on a task's min/max util use"
	default n

config SCHED_PERF_CTRL
	bool "Perf ctrl interface of sched"
	depends on HONOR_PERF_CTRL
	default n

config HONOR_TASK_RAVG_SUM                                                                                                                                                                                       
        bool "Honor task normalized running time sum"
        default n
        help
          Sum all normalized running time for each task.

config HONOR_SCHED_STAT_YIELD
        bool "Honor yield task time statistics"
        default n
endmenu
```

## drivers/platform_drivers/modem/Kconfig
```kconfig
menu "Modem"
config MODEM_DRIVER
	tristate "ap+modem config for fusion platform"
	default n
	help
	ap+modem config support.

config EXTRA_MODEM_DRIVER
	bool "extra_modem config"
	default n
	help
	ap+modem config support.

config EXTRA_MODEM_DRIVER_MBB
	bool "MBB extra_modem config"
	default n
	help
	ap+modem MBB config support

config VOWIFI_NEW_FRW
	bool "vowifi android n&o frw diff"
	default n
	help
	vowifi android n&o frw diff

config MODEM_PS_FUSION_VERSION
        tristate "modem ps fusion version"
        default n
        help
        modem ps fusion

source "drivers/platform_drivers/modem/drv/Kconfig"
endmenu
```

## drivers/runtime_verification/Kconfig
```kconfig
#
# Runtime Verification configuration
#
menu "honor runtime verification support"

config RUNTIME_VERIFICATION_LOGGER
	tristate "runtime verification log driver"
	default n
	depends on LOGGER
	select RUNTIME_VERIFICATION_INSTRUMENT
	help
	  This adds support for verification event buffer.


config RUNTIME_VERIFICATION_INSTRUMENT
	tristate "runtime verification instrument driver"
	default n
	depends on KRETPROBES
	depends on RUNTIME_VERIFICATION_LOGGER
	help
	  This adds support for kernel functional instrument.

source "drivers/runtime_verification/module_test/Kconfig"
endmenu
```

## drivers/runtime_verification/module_test/Kconfig
```kconfig
config RUNTIME_VERIFICATION_TEST
	tristate "runtime verification test support"
	depends on RUNTIME_VERIFICATION
	default n
	help
	  Say m here to enable runtime verification module test.
```

## fs/kernfs/Kconfig
```kconfig
# SPDX-License-Identifier: GPL-2.0-only
#
# KERNFS should be selected by its users
#

config KERNFS
	bool
	default n

config KERNFS_RWSEM
	bool "for kernfs rwsem"
	default n
	help
	  switches the global kernfs_rwsem to per-fs lock
```

## include/hwnet/booster/Kconfig
```kconfig
config HN_BOOSTER
    tristate "Network-related optimization acceleration features."
    default n
    help
      Provide network acceleration, business quality assessment
      and other functions.
config HN_PACKET_FILTER_BYPASS
    tristate "honor iptables and bpf interception detection and bypass module"
    default n
    help
      Detect whether the network packet of foreground uid is dropped by netfilter
      or bpf, and then try to recovery it.
config HN_NETWORK_QOE
    tristate "Network-Qoe optimization features."
    default n
    help
      Provide network Qoe feature.
config HW_NETWORK_SLICE
    tristate "network slice management features."
    default n
    help
      Provide ip report and route selection feature.
config HW_ICMP_PING_DETECT
    tristate "icmp ping detect features."
    default n
    help
      Provide icmp ping detect feature.
config TCP_CONG_ALGO_CTRL
    tristate "Dynamic control tcp congestion algorithms"
    default n
    help
      Detect network state and uid state to change tcp congestion algorithm
config HW_PACKET_TRACKER
    tristate "CONFIG HW PACKET TRACKER."
    default n
    help
      Tracking data transport time in kernel and report chr if detect slow.
config APP_ACCELERATOR
    tristate "app accelertor"
    default n
    help
      app accelertor
config HW_STEADY_SPEED_STATS
    tristate "steady speed statistics"
    default n
    help
      count the steady speed for specific uid.
config STREAM_DETECT
    tristate "stream detect features."
    default n
    help
      Provide stream anomaly detection feature.
config HONOR_FEATURE_PRINT_PID_NAME
    bool "print pid and name of the process who used connect function"
    default n
    help
        Honor pid_socket, please choose it.
```

## include/hwnet/hnril/Kconfig
```kconfig
config HN_VSIM
    tristate "send vsim statistics to RIL via netlink."
    default n
    help
      This module send vsim statistics to RIL via netlink.
```

## include/hwnet/hw_dual_connection/Kconfig
```kconfig
config HW_DC_MODULE
	tristate "kernel honor custom packet dual connection for wlan"
	default n
	help
		This module adds support dual connection feature.
```

## include/hwnet/waudio/Kconfig
```kconfig
config HW_WAUDIO_MODULE
	tristate "kernel honor custom packet wifi audio for wlan"
	default n
	help
		This module adds support wifi audio feature.
```

## kernel/Kconfig.dubai
```kconfig
# SPDX-License-Identifier: GPL-2.0-only
config HONOR_DUBAI_COMMON
	bool "Honor DUBAI Common Part"
	default n
	help
	  Control DUBAI to insert code in kernel

config HONOR_DUBAI_GPU_COMMON
	bool "Honor DUBAI Gpu Common Part"
	default n
	help
	  Control DUBAI to insert Code of gpu part in kernel
```

## kernel/Kconfig.kstate
```kconfig
# SPDX-License-Identifier: GPL-2.0-only
config KSTATE_COMMON
	bool "Kstate Common Part"
	default n
	help
	  Control Kstate to insert code in kernel
```

## kernel/hwqos/Kconfig
```kconfig
config HW_QOS_THREAD
    bool "iaware 5.0 qos thread"
    default n
    help
      if set, qos thread is propagated by lock&binder, and picked first in lock's waitlist
config HW_RTG_SCHED_LOCK_PI
    bool "mutex&rwsem rt trans switches in chipset"
    default n
    depends on HW_QOS_THREAD
    help
      if set, mutex&rwsem rt trans will be enabled in the chipset
```

## kernel/rainbow/Kconfig
```kconfig
config RAINBOW
	tristate "rainbow"
	default n
	help
	  rainbow framework.

config RAINBOW_GKI
	bool "rainbow for gki"
	depends on RAINBOW
	default n
	help
	  rainbow framework for gki.

config RAINBOW_REASON
	bool "rainbow_reason"
	depends on RAINBOW
	default n
	help
	  rainbow reason record reset reason.

config RAINBOW_HIMNTN
	bool "rainbow_himntn"
	depends on RAINBOW
	default n
	help
	  rainbow himntn control kernel mntn.

config RAINBOW_TRACE
	bool "rainbow_reason"
	depends on RAINBOW
	default n
	help
	  rainbow trace will record irq and schedule trace log.
```

## kernel/sched/favor_small/Kconfig
```kconfig
config HW_FAVOR_SMALL_CAP
	bool "Honor config favor small capacity"
	default n
	help
	  users turn on or off the switch through ioctrl, when
	  the switch is turned on, the task witch TIF_FAVOR_SMALL_CAP
	  will select little core.
```
