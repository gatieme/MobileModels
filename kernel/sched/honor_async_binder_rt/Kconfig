## kernel/sched/honor_async_binder_rt/Kconfig
```kconfig
# Add iAware async binder rt
config HN_SET_ASYNC_BINDER_RT
	bool "iaware 7.0 set async binder rt"
	default n
	help
	  if set, the priority of opposite binder thread will be set to realtime
```

## kernel/sched/honor_rt_sched/Kconfig
```kconfig
menu "HONOR RT Capacity Aware"

config HONOR_RT_CAS
	bool "HONOR RT Capacity Aware RQ Selection"
	default n
	help
	  RT tasks detects capacity when CPU selection.

config HONOR_RT_ACTIVE_LB
	bool "HONOR RT Capacity Aware Misfit Task"
	default n
	help
	  Check and migrate the RT process to a more suitable
	  CPU in the tick.

endmenu
```

## kernel/sched/honor_rtg_sched/Kconfig
```kconfig
menu "Honor Related Thread Group"

config HONOR_RTG
	bool "Honor Related Thread Group"
	default n
	help
	  Set real time scheduler for dedicated thread

config HONOR_RTG_BOOST
	bool "Honor Related Thread Group"
	default n
	help
	  Sensing boost in RTG groups

config HONOR_RTG_NORMALIZED_UTIL
	bool "Honor RTG Normalized Util and Preferred-Cluster"
	depends on HONOR_RTG
	default n
	help
	  Use normalized util as rtg util, also enabled Preferred-Cluster

config CLUSTER_NORMALIZED_UTIL
	bool "Global Normalized Util and Preferred-Cluster"
	default n
	help
	  Use user set freq as min freq, also enabled Preferred-Cluster

config HONOR_RTG_UCLAMP_UTIL
	bool "Honor RTG Uclamp Util"
	depends on HONOR_RTG
	depends on SCHED_TASK_UTIL_CLAMP
	default n
	help
	  Used uclamp min util as rtg util

config HONOR_RTG_WALT
	bool "Use WALT to track the RTG tasks load"
	depends on HONOR_RTG
	default n
	help
	  Set real time scheduler for dedicated thread

config HONOR_RTG_CPU_TIME
	bool "Steal CPU time from RTG"
	depends on HONOR_RTG_WALT
	help
	  Record cpu_time in RTG Group

config HONOR_RTG_FRAME
	bool "Frame RTG Scheduling"
	depends on HONOR_RTG
	default n
	help
	  Use frame_rtg group

config HONOR_RTG_AUX
	bool "RTG AUX Group"
	depends on HONOR_RTG_FRAME
	default n
	help
	  Use honor rme optimize

config HONOR_RTG_FRAME_RME
	bool "Frame RTG RME Optimize"
	depends on HONOR_RTG_FRAME
	default n
	help
	  Use honor rme optimize

config HONOR_RTG_DEBUG
	bool "Honor RTG DebugFS"
	depends on HONOR_RTG_FRAME || HONOR_RTG_AUX
	default n
	help
	  If set, debug node will show rtg threads
	  /proc/sched_frame_debug
	  /proc/sched_aux_debug

config HONOR_RTG_TRACE
	bool "Honor RTG Tracing"
	depends on HONOR_RTG
	default n
	help
	  If set, there will be rtg tag on systrace

config HONOR_RTG_PERF_CTRL
	bool "Honor RTG Perl Ctrl Interface"
	depends on HONOR_RTG
	depends on HONOR_PERF_CTRL
	default n
	help
	  Use the /dev/hw_perf_ctrl to operate the RTG through ioctl.

config HONOR_RTG_FRAME_NO_FORCE_FAST_DOWN
       bool "Schedutil frame_update do not force skip_min_sample_time"
       depends on !HONOR_BOOST
       default n
       help
         Boosted scene like appstart do not want cpu to fast ramp
         down. Frame sched should not break it. This option won't
         set skip_min_sample_time for freq update marked by
         sched_set_group_normalized_util() if userspace has
         configured fast_ramp_down to 0.
         Please say Y.

config HONOR_RTG_PSEUDO_TICK
	bool "update rtg by pseudo tick"
	depends on HONOR_RTG_FRAME
	default n
	help
	  In the 120-frame scenario, the tick is used to update the
	  RTG information. Therefore, high-precision timers are used
	  to implement pseudo ticks.

config USE_RTG_FRAME_SCHED
	bool "use rtg frame sched full function"
	depends on HONOR_RTG_FRAME
	default n
	help
	  If this cfg is diabled, we only use RT function of RTG_FRAME,
	  margin and min_util setting not work.

config AUX_RTG_BOOST_UTIL
	bool "boost_util function for aux-rtg threads"
	depends on HONOR_RTG_AUX
	default n
	help
	  If this config is disabled, we only set RT function of AUX-RTG threads.

config HONOR_RTG_KEY_LIST
	bool "switch for rtg key threads list"
	depends on HONOR_RTG
	default n
	help
	  If enabled, we support rtg key threads list.

choice
	prompt "Honr RTG util control mode"
	default HONOR_RTG_FRAME_USE_NORMALIZED_UTIL if HONOR_RTG_NORMALIZED_UTIL
	default HONOR_RTG_FRAME_USE_MIN_UTIL if !HONOR_RTG_NORMALIZED_UTIL
	default HONOR_RTG_FRAME_USE_MIN_UTIL if !HONOR_CPU_FREQ_GOV_SCHEDUTIL
	help
	  Provides multiple methods to deliver the RTG util to control
	  core selection and frequency modulation.

config HONOR_RTG_FRAME_USE_MIN_UTIL
	bool "change group util by min util"
	depends on HONOR_RTG_UCLAMP_UTIL
	depends on HONOR_RTG_FRAME
	help
	  This is done by setting min util for all threads in the RTG group.

config HONOR_RTG_FRAME_USE_NORMALIZED_UTIL
	bool "change group util by normalized util"
	depends on HONOR_RTG_NORMALIZED_UTIL
	help
	  This is done by setting normalized-util and prefer-cluster for
	  the RTG group.
endchoice
endmenu
```

## kernel/sched/hw_cluster/Kconfig
```kconfig
config HW_SCHED_CLUSTER
	bool "Honor related thread group"
	default n
	help
	  set real time scheduler for dedicated thread

config HW_SCHED_CLUSTER_DEBUG
	bool "Honor related thread group debug"
	default n
	help
	  set real time scheduler for dedicated thread
```

## mm/mem_stats/Kconfig
```kconfig
config MEM_STATS
	bool "Enable mem stats"
	default n

config MEM_REPORT
	bool "Enable mem report"
	depends on MEM_STATS
	default n

config CMA_REPORT
	bool "CMA alloc timeout or fail report event"
	depends on MEM_REPORT
	default n

config DMA_BUF_REPORT
	bool "DMA-BUF alloc timeout or fail report event"
	depends on MEM_REPORT
	default n

config GPU_MEM_REPORT
	bool "GPU alloc timeout or fail report event"
	depends on MEM_REPORT
	default n

config KMALLOC_REPORT
	bool "KMALLOC alloc fail report event"
	depends on MEM_REPORT
	default n

config BUDDY_INFO_REPORT
	bool "Enable buddy info event report"
	depends on MEM_REPORT
	default n

config MEM_DETECT
	bool "if free page、file page、anon page anomal, event report"
	depends on MEM_STATS
	default n

config ISOLATED_DETECT
	bool "if isolated anomal, event report"
	depends on MEM_DETECT
	default n
```

## mm/xreclaimer/Kconfig
```kconfig
config XRECLAIMER
	bool "Fast process memory reclaimer implemented"
	depends on MMU
	help
	  Say Y here if you want to support fast process memory reclaimer
```

## msm-kernel/drivers/blackbox/platform/Kconfig
```kconfig
# SPDX-License-Identifier: GPL-2.0
config DFX_RAINBOW_HIMNTN
	depends on BLACKBOX
	default n
		bool "rainbow_himntn"
	help
		rainbow himntn control kernel mntn.
```

## msm-kernel/drivers/block/zram/hyperhold/Kconfig
```kconfig
# SPDX-License-Identifier: GPL-2.0
# Hyperhold container backend device configuration

# Selected when system need hyperhold container
config HYPERHOLD_CORE
	bool "Hyperhold container device support"
	depends on HYPERHOLD
	default n
	help
	  Say Y here if you want to use the hyperhold
	  as the backend device in ZRAM.
	  If unsure, say N here.
	  This module can't be compiled as a module,
	  the module is as one part of the ZRAM driver.

config HYPERHOLD_DEBUG_FS
	bool "Hyperhold debug fs proc"
	depends on HYPERHOLD
	default n
	help
	  Say Y here if you want to use debug proc of
	  hyperhold

config HYPERHOLD_QCOM
	bool "Hyperhold adapt to qcom"
	depends on HYPERHOLD
	default n
	help
	  Say Y here if you want to adapt to qcom

config MAS_BLK
	bool "Hyperhold block"
	depends on HYPERHOLD
	default n
	help
	  Say Y here if you want to use interfaces
	  provided by the storage

config HYPERHOLD_CRYPTO_DEBUG
	bool "Hyperhold crypto debug testcase insert"
	depends on HYPERHOLD
	default n
	help
	  Say Y here if you want to use debug proc of
	  hyperhold crypto debug testcase

config RAMTURBO
	bool "RAM Turbo"
	depends on HYPERHOLD_CORE
	default n
	help
	  RAM Turbo features, swapout background tasks

config OBJECT_PROTECT
	bool "Enable object protect"
	depends on RAMTURBO && MMU
	default n
	help
	  object protect for the memory of the specified label to protected

config MEMCG_SKIP_RECLAIM
	bool "Enable skip memcg reclaim anon"
	depends on RAMTURBO
	default n
	help
	 Allow kswapd & zswapd to skip the specified memcg when reclaiming anon memory.
```

## msm-kernel/drivers/connectivity/hi11xx/platform/Kconfig
```kconfig
menuconfig HI1102_PLATFORM
	tristate "Hisilicon Wireless Connectivity Hi11xx Platform Module"
	depends on CONNECTIVITY_HI110X
	default m



if HI1102_PLATFORM

config HI1102_PLAT_HW_CHR
  bool "Hisilicon 1102 platform chr log"
  default y



config HI1102_PLAT_OAL
  bool "Hisilicon 1102 platform oal module"
  default y
  select HI110X_SDIO_STD_CARD_SUPPORT
  select HI110X_SDIO_DETECT_FUNCTION



config HI1102_PLAT_FRW
  bool "Hisilicon 1102 platform framework module"
  default y



config HI1102_PLAT_OAM
  bool "Hisilicon 1102 platform oam module"
  default y



config HI1102_PLAT_SDT
  bool "Hisilicon 1102 platform sdt module"
  default y



config HI1102_PLAT_PS
  bool "Hisilicon 1102 platform ps module"
  default y



config HI1102_PLAT_PM
  bool "Hisilicon 1102 platform power manager module"
  default y



config HI1102_PLAT_MAIN
  bool "Hisilicon 1102 platform main module"
  default y



config HI110X_PLAT_BB
  bool "Hisilicon 110x platform bbox  module"
  default n



endif
```

## msm-kernel/drivers/connectivity/hi11xx/wifi/Kconfig
```kconfig
menuconfig HI1102_WIFI
	tristate "Hisilicon Wireless Connectivity WiFi Module"
	depends on CONNECTIVITY_HI110X && WIRELESS && CFG80211
	select WIRELESS_EXT
	select WEXT_SPY
	select WEXT_PRIV
	default m



if HI1102_WIFI
config HI1102_WIFI_HMAC
  bool "Hisilicon 1102 wifi hmac module"
  default y



config HI1102_WIFI_WAL
  bool "Hisilicon 1102 wifi wal module"
  default y



config HI1102_WIFI_MAIN
  bool "Hisilicon 1102 wifi main module"
  default y



config HI1102_WIFI_DMAC
  bool "Hisilicon 1102 wifi dmac module"
  default n



endif
```

## msm-kernel/drivers/cpld/Kconfig
```kconfig
menuconfig CPLD_DRIVER
	bool "cpld diver"
	default n
	help
	  If you say yes here you get support for cpld.
```

## msm-kernel/drivers/easy_shell/Kconfig
```kconfig
#
# easy shell configuration
#

config DFX_ECALL
	bool "DFX blackbox ecall"
	default n
	help
	  If you say yes here you get support for huawei blackbox ecall.
```

## msm-kernel/drivers/huawei_platform/hwpower/battery/Kconfig
```kconfig
# SPDX-License-Identifier: GPL-2.0
source "drivers/huawei_platform/hwpower/battery/qbg_log/Kconfig"
```

## msm-kernel/drivers/huawei_platform/hwpower/battery/qbg_log/Kconfig
```kconfig
config HUAWEI_QBG_LOG
	tristate "huawei qbg adsp log driver"
	default n
	help
	  Enable this option to qbg adsp log.
```

## msm-kernel/drivers/huawei_platform/hwpower/hardware_ic/switch_capacitor/Kconfig
```kconfig
# SPDX-License-Identifier: GPL-2.0
#
# huawei switch capacitor for direct charge drivers
#

config SCHARGER_V600
	bool "scharger_v600_for_direct_charge"
	depends on SWITCHCAP
	default n
	help
	  Say Y here to enable scharge_v600 driver.
	  scharge_v600 is a fixed ratio high voltage high power switched capacitor
	  and low voltage loadswtich ic.

config QPLAT_CHARGER
	bool "qplat_charger_for_direct_charge"
	depends on SWITCHCAP
	default n
	help
	  Say Y here to enable qcom_platform_charger driver.
	  This driver is used to apply the Qcom's buck charger as aux SC.
```

## msm-kernel/drivers/huawei_platform/mntn/Kconfig
```kconfig
config HUAWEI_PLATFORM_MAINTAIN
	bool "Huawei platform maintain module support"
	default n
	help
	  Say yes here to support the huawei platform maintain module

config MNTN_FULLDUMP
	bool "Support Maintainance Fulldump"
	default n
	help
	  This driver supports maintainance fulldump, etc.

config HW_MNTN_FACOTORY
	bool "Huawei Factory Model"
	default n
	help
	  This tran factory to kernel.

config DFX_FUSE_DUMP_SWITCH
	bool "fuse dump switch"
	default n
	help
	  This support dump switch for fuse device

source "drivers/huawei_platform/mntn/blackbox/Kconfig"
```

## msm-kernel/drivers/huawei_platform/power/battery/battery_voltage/Kconfig
```kconfig
# SPDX-License-Identifier: GPL-2.0+
#
# battery voltage driver
#

config HUAWEI_BATTERY_VOLTAGE
	bool "huawei BATTERY VOLTAGE"
	default n
	help
	  Say Y here to enable battery voltage driver
```

## msm-kernel/drivers/huawei_platform/usb/hw_pogopin/Kconfig
```kconfig
#
# huawei pogopin drivers
#

config POGO_PIN
	bool "huawei pogopin support"
	default n
	help
	  Say Y here to enable pogopin driver.


config POGOPIN_EXTCON
	bool "pogopin extcon support"
	default n
	help
	  Say Y here to enable pogopin extcon driver.
```

## msm-kernel/drivers/huawei_platform/usb/pd/Kconfig
```kconfig
# SPDX-License-Identifier: GPL-2.0
source "drivers/huawei_platform/usb/pd/richtek/Kconfig"
config HUAWEI_PD
        bool "huawei_pd"
        default n
        help
          Say Y here to enable huawei_pd driver.

config HUAWEI_PD_THIRDPARTY
        bool "huawei_pd_thirdparty"
        default n
        help
          Say Y here to enable huawei_pd_thirdparty driver.
```

## msm-kernel/drivers/irda/Kconfig
```kconfig
config HUAWEI_IR_CORE
	tristate "huawei infrared user interface"
	default n
	help
	  Enable this option to enable the infrared user interface
	  (e.g. /dev/ir). This interface passes infrared CIR data
	  to or from userspace, which is needed for IR transmitting
	  (aka "blasting") and for the ir daemon.

config HUAWEI_IR_PWM
	tristate "huawei PWM IR transmitter"
	help
	   Say Y if you want to use a PWM based IR transmitter.
```

## msm-kernel/drivers/shutdown_wdt/Kconfig
```kconfig
config HW_SHUTDOWN_WDT
	tristate "for SHUTDOWN WDT"
	default n
	help
	  This Macro is set y when the compile instruction has HW_SHUTDOWN_WDT param
```

## msm-kernel/drivers/soc/qcom/get_fuse/Kconfig
```kconfig
config HUAWEI_GET_FUSE
	tristate "get_fuse module governor"
	default n
	help
	  This get_fuse helps read efuse register for voltage bias.
	  To compile this driver as a module, choose M here: the
	  module will be called get_fuse.
```
