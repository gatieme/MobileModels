## msm-kernel/drivers/soc/qcom/pil-q6v5-mss/Kconfig
```kconfig
#
# Huawei modem interface
#
config HUAWEI_MODEM_CRASH_LOG
	tristate "modem crash exception for apr"
	help
	  say yes here to mean enable HUAWEI_MODEM_CRASH_LOG dump
```

## msm-kernel/kernel/sched/hw_eas/Kconfig
```kconfig
config HW_EAS_SCHED
	bool "Huawei EAS scheduler"
	default n
	depends on ARCH_HW
	help
	  Huawei EAS scheduler, it makes scheduling more
	  efficient and energy-saving.

config HW_MULTI_MARGIN
	bool "Huawei multiple margin"
	default n
	depends on HW_SCHED_CLUSTER
	depends on HW_EAS_SCHED
	help
	  Allow each cluster has its own capacity_margin/sd_capacity_margin.

config HW_MULTI_MARGIN_RT
	bool "Huawei rt multiple margin"
	depends on SCHED_WALT
	default n
	help
	  Allow each cluster has its own capacity_rt_misfit_margin.

config HW_BOOST
	bool "Huawei boost support"
	depends on HW_EAS_SCHED
	default n
	help
	  macro switch of boost

config HW_BOOT_BOOST
	bool "Huawei boot boost support"
	depends on HW_BOOST
	default n
	help
	  on system boot scenarios, it is used to accelerate
	  system startup.

config HW_FORK_BOOST
	bool "Huawei fork boost support"
	depends on HW_BOOST
	default n
	help
	  on fork scenarios, it is used to set task boost to
	  512, which is used to run the task quickly.

config HW_GLOBAL_BOOST
	bool "Huawei global boost support"
	depends on HW_BOOST
	default n
	help
	  on some interactive scenarios, it is used to enable
	  boost function in a short time to improve performance.

config HW_NEGATIVE_BOOST
	bool "Huawei negative boost support"
	depends on HW_BOOST
	default n
	help
	  We can increase the value of boost to make the task select
	  the large core, or reduce the value of boost to make the task
	  select the small core. At this time, the range of boost is
	  - 100 to 100.

config HW_SPREAD_TASK
	bool "Huawei spread task"
	depends on HW_EAS_SCHED
	default n
	help
	  when each CPU in the cluster is overloaded, the packaged
	  small tasks need to be split to improve performance.

config HW_EAS_TRACE
	bool "Huawei EAS Trace"
	depends on HW_EAS_SCHED
	default n
	help
	  enable huawei eas trace.

config HW_EAS_SYSFS
	bool "Huawei EAS sysfs"
	depends on SCHED_WALT
	default n
	help
	  True when hw_eas features sysfs (like pred_load window tunnable) enable
```

## msm-kernel/kernel/sched/hw_migration_notify/Kconfig
```kconfig
config HW_MIGRATION_NOTIFY
	bool "Huawei task migration notify freq change"
	depends on HW_EAS_SCHED || HW_CPU_FREQ_GOV_SCHEDUTIL
	default n
	help
	  tasks migration notify frequency change.
```

## net/hw_dpi_mark/Kconfig
```kconfig
config HN_DPIMARK_MODULE
	tristate "kernel honor custom packet mark based on DPI rules"
    default n
    help
	  This module adds support mark packets based on DPI rules
```

## platform_source/audio/drivers/Kconfig
```kconfig
if SND_SOC_PLATFORM
source "platform_source/audio/drivers/da_separate/Kconfig"
endif

source "platform_source/audio/drivers/hifi_dsp/Kconfig"
source "platform_source/audio/drivers/hifi_mailbox/Kconfig"
source "platform_source/audio/drivers/soundtrigger/Kconfig"
source "platform_source/audio/drivers/soc_mad/Kconfig"
source "platform_source/audio/drivers/rdr/Kconfig"
```

## platform_source/audio/sound/soc/codecs/vendor/asp_codec_codecless/Kconfig
```kconfig
config SND_SOC_ASP_CODEC_V1
	tristate "HI Soc codecless series audio codec support for v1"

config SND_SOC_ASP_CODEC_V2C
	tristate "HI Soc codecless series audio codec support for v2c"

config SND_SOC_ASP_CODEC_V2N
	tristate "HI Soc codecless series audio codec support for v2n"

config SND_SOC_ASP_CODEC_V2CP
	tristate "HI Soc codecless series audio codec support for v2cp"

config SND_SOC_ASP_CODEC_AXI2TDM
	tristate
	default y if SND_SOC_ASP_CODEC_V2N=y || SND_SOC_ASP_CODEC_V2C=y || SND_SOC_ASP_CODEC_V2CP=y
	default m if SND_SOC_ASP_CODEC_V2N=m || SND_SOC_ASP_CODEC_V2C=m || SND_SOC_ASP_CODEC_V2CP=m

config SND_SOC_ASP_CODEC_MAD_V2
	tristate
	default y if SND_SOC_ASP_CODEC_V2C=y

config SND_SOC_ASP_CODEC_CONTROL
	tristate
	default y if SND_SOC_ASP_CODEC_V1=y
	default m if SND_SOC_ASP_CODEC_V1=m

config SND_SOC_ASP_CODEC_UTILS
	tristate
	default y if SND_SOC_ASP_CODEC_V1=y
	default m if SND_SOC_ASP_CODEC_V1=m

config SND_SOC_ASP_CODEC_STORE
	tristate
	default y if SND_SOC_ASP_CODEC_V1=y
	default m if SND_SOC_ASP_CODEC_V1=m

config SND_SOC_ASP_CODEC_PLAY_PATH
	tristate
	default y if SND_SOC_ASP_CODEC_V1=y
	default m if SND_SOC_ASP_CODEC_V1=m

config SND_SOC_ASP_CODEC_8PA_PATH
	tristate
	default y if SND_SOC_ASP_CODEC_V1=y
	default m if SND_SOC_ASP_CODEC_V1=m

config SND_SOC_ASP_CODEC_UPLINK_PATH
	tristate
	default y if SND_SOC_ASP_CODEC_V1=y
	default m if SND_SOC_ASP_CODEC_V1=m

config SND_SOC_ASP_CODEC_AU_PA_PATH
	tristate
	default y if SND_SOC_ASP_CODEC_V1=y
	default m if SND_SOC_ASP_CODEC_V1=m

config SND_SOC_ASP_CODEC_BTFM_PATH
	tristate
	default y if SND_SOC_ASP_CODEC_V1=y
	default m if SND_SOC_ASP_CODEC_V1=m

config SND_SOC_ASP_CODEC_SIDETONE_PATH
	tristate
	default y if SND_SOC_ASP_CODEC_V1=y
	default m if SND_SOC_ASP_CODEC_V1=m
```

## platform_source/basicplatform/drivers/net/ethernet/hisi/Kconfig
```kconfig
config NET_VENDOR_HISI_HIXGEMAC
        bool "Hisilicon XGE MAC"
        help
          If you have a Hisilicon xGE MAC, say Y.

config NET_VENDOR_HIXGEMAC_10CC
        bool "Hisilicon XGE PMA 10CC"
	depends on NET_VENDOR_HISI_HIXGEMAC
        help
          If XGE uses the 10CC PMA, say Y.
```

## platform_source/basicplatform/drivers/pci/controller/Kconfig
```kconfig
#
# Kirin PCIe driver configuration
#

config HIPCIE_CORE
	bool "HiPCIe controller"
	depends on PCI
	depends on PCI_MSI_IRQ_DOMAIN
	select PCIEPORTBUS
	help
	  Say Y here to enable PCIe controller support on Kirin SoCs.

config HIPCIE_CTRL
	tristate "HiPCIe ctrl"
	depends on HIPCIE_CORE
	help
	  Say Y here to enable PCIe controller support on Kirin SoCs.

config HIPCIE_PHY
	tristate "HiPCIe phy"
	depends on HIPCIE_CORE
	help
	  Say Y here to enable PCIe phy support on Kirin SoCs.

config HIPCIE_IDLE
	tristate "HiPCIe IDLE"
	depends on HIPCIE_CORE
	help
	  Say Y here to enable PCIe Idle support on Kirin Soc.

config HIPCIE_TEST
	tristate "HiPCIe test"
	depends on HIPCIE_CTRL
	depends on HIPCIE_PHY
	help
	  Say Y here if you want to use testcases for PCIe controller on Kirin SoCs.

config HIPCIE_SLT
	tristate "HiPCIe slt"
	depends on HIPCIE_CORE
	help
	  Say Y here to enable PCIe Slt test.

config HIPCIE_TRAP_HOST
	tristate "HiPCIe controller-guest communicate with host"
	depends on HIPCIE_CORE

source "platform_source/basicplatform/drivers/pci/controller/platform/Kconfig"
```

## platform_source/basicplatform/drivers/pci/controller/pcie_vm/Kconfig
```kconfig
#
# Kirin PCIe driver platform configuration
#

config HIPCIE_VM_IOCTL
	tristate "HiPCIe controller-vm-ioctl"
	depends on HIPCIE_VM_CORE
```

## platform_source/basicplatform/drivers/pci/controller/platform/Kconfig
```kconfig
#
# Kirin PCIe driver platform configuration
#

config HIPCIE_OCT
	tristate "HiPCIe controller-Oct"
	select HIPCIE_CORE
	select HIPCIE_CTRL
	select HIPCIE_PHY

config HIPCIE_NSV
	tristate "HiPCIe controller-Nsv"
	select HIPCIE_CORE
	select HIPCIE_CTRL
	select HIPCIE_PHY
```

## platform_source/basicplatform/drivers/usb/usb-typec/Kconfig
```kconfig
config VENDOR_USB_TYPEC
	bool "Hisilicon USB Typei-C Driver"
	help
	  Say Y to enable Hisilicon USB Typec Driver

config HISI_USB_TYPEC_DBG
	bool "Hisilicon USB Type-C driver verbost debug infomation."
	depends on VENDOR_USB_TYPEC
	help
	  Say Y here if you want verbost debug infomation. If unsure, say N.

config USB_VBUS_CTRL
	bool "Hisilicon USB type-c rt1711 power controller"
	depends on TCPC_CLASS
	help
	  Say Y to enable rt1711 vbus gpio control power

config CS32G_USB_PD
	bool "Cs32g050 Usb Pd Driver"
	help
	  Say Y to enable Cs32g050 Usb Pd Driver

source "platform_source/basicplatform/drivers/usb/usb-typec/hisi-tcpc/Kconfig"
```

## platform_source/isp/drivers/isp/Kconfig
```kconfig
config ISP
    tristate "Histar ISP device"
    depends on REMOTEPROC
    depends on ARCH_HISI
    depends on RPMSG

config HISP_RPMSG
    tristate "HISP RPMSG bus driver"
    select RPMSG
    select VIRTIO

config HISP_DEBUG
	bool "hisp debug"
	default n
	help
		Say yes here to support hisp debug.

config HISP_DPM
	tristate "HISP DPM(digital power monitor) support"
	depends on DPM_HWMON
	default n
	help
		This framebuffer driver supports dpm function.

config HISP_EXCLUDE_NOC_DEBUG
	bool "hisp exclude noc modid debug"
	default n
	help
		Say yes here to not support hisp noc modid debug.

config HISP_FFA_SUPPORT
	bool "hisp choose ffa support"
	depends on FFA_SUPPORT
	default n
	help
		Say yes here to support ffa.

config ISP_BUF_PRIVATIZE
	bool "hisp buffer privatize"
	default n
	help
		Say yes here to support hisp buffer privatize.
```

## platform_source/see/drivers/hicrypto/Kconfig
```kconfig
menu "hicrypto options"

config CRYPTO_HICRYPTO
	tristate "Support Hisilicon hardware crypto engine driver"
	select CRYPTO_USER
	select CRYPTO_ENGINE
	select CRYPTO_USER_API
	select CRYPTO_USER_API_HASH
	select CRYPTO_USER_API_SKCIPHER
	select CRYPTO_USER_API_AEAD
	default n
	help
		vendor hardware crypto engine driver support

config CRYPTO_HICRYPTO_SHA
	tristate "Support Hisilicon hardware hash crypto"
	depends on CRYPTO_HICRYPTO
	default n
	help
	  vendor hardware crypto engine hash support

config CRYPTO_HICRYPTO_CIPHER
	tristate "Support Hisilicon hardware cipher crypto"
	depends on CRYPTO_HICRYPTO
	default n
	help
	  vendor hardware crypto engine cipher support

config CRYPTO_HICRYPTO_AEAD
	tristate "Support Hisilicon hardware aead crypto"
	depends on CRYPTO_HICRYPTO
	default n
	help
	  vendor hardware crypto engine aead support
endmenu
```

## security/eima/Kconfig
```kconfig
# Copyright (c) Honor Device Co., Ltd. 2017-2020. All rights reserved.
#
# MAGIC Integrity Measurement Architecture(EIMA) configuration
#

config HONOR_EIMA
	bool "enables HONOR MAGIC Integrity Measurement Architecture"
	default n
	help
	  The MAGIC Integrity Measurement Architecture (EIMA)
	  framework is composed of a set of subsystems that
	  are needed to measure the integrity of the platform
	  and inform the decision on platform integrity to
	  clients who seek such services.
config HONOR_ENG_EIMA
	bool "Honor MAGIC for engineering mode debug"
	depends on HONOR_EIMA
	default n
	help
	  This option should only be enabled for engineering mode & debug test.
	  In engineering mode, EIMA will be turnoff(default) after init,
	  tester can use supported interface to turn it on, and do debug test.
config HONOR_EIMA_ACCESS_CONTROL
	bool "enables one process access control by verifying the integrity of other processes"
	depends on HONOR_EIMA
	default n
	help
	  If the option is on, one process can request EIMA
	  to verify the integrity of other processes by including libeima.
	  The signature of the RE segment of the other process is generated on
	  the Signature Center of Honor CBG and sent to EIMA as an input.
	  The signature is verified through libeima with the corresponding public
	  key. After successful verification, the hash is compared with the hash
	  data computed by EIMA. Then EIMA returns the result to the process.
config HONOR_EIMA_GKI
	bool "Honor MAGIC for GKI"
	depends on HONOR_EIMA
	default n
	help
	  This option should only be enabled for engineering mode & debug test.
	  In engineering mode, EIMA will be turnoff(default) after init,
	  tester can use supported interface to turn it on, and do debug test.
```

## security/hw_root_scan/Kconfig
```kconfig
#
# Copyright (c) Honor Device Co., Ltd. 2016-2018. All rights reserved.
# Description: Honor root scanner configuration
# Author:likun <quentin.lee.>
# Create: 2016-06-18
#

menu "Honor root scanner"

config HN_ROOT_SCAN
	tristate "enables Honor root scanner"
	default n
	help
	  This option enables support for Honor root scanner in kernel space.
	  Honor root scanner will check if the device is got rooting or not
	  base on five items, kernel code integrity, system call table
	  integrity, SeLinux status, SeLinux hooks status, and root processes.

config HN_ROOT_SCAN_ENG_DEBUG
	bool "Honor root scanner for engineering mode debug"
	depends on HN_ROOT_SCAN
	default n
	help
	  This option should only be enabled for engineering mode & debug test.
	  In engineering mode, root scanner will be turnoff(default) after init,
	  tester can use supported interface to turn it on, and do debug test.

endmenu
#a blank line must be existed
```

## security/kernel_harden/Kconfig
```kconfig
#
# Honor Kernel Harden
#

menu "Honor Kernel Harden"

config HONOR_KERNEL_STACK_RANDOMIZE
	bool "stack randomize"
	depends on ARM64 && !KASAN
	default n
	help
	  Randomizes the base address of process's kernel stack.

config HONOR_KERNEL_STACK_RANDOMIZE_STRONG
	bool "stack randomize strong"
	depends on ARM64 && !KASAN
	default n
	help
	  Randomizes the base address of process's thread_info struct.

config HONOR_KERNEL_STACK_NX
	bool "stack non executeable"
	depends on ARM64
	default n
	help
	  Set process's kernel stack with non execution.

config HONOR_KERNEL_MODULE_RANDOMIZE
	bool "module randomize"
	depends on ARM64
	default n
	help
	  Randomizes the base address of loaded kernel module.

config HONOR_KASLR_DEBUGFS
	bool "kaslr debugfs interface"
	depends on DEBUG_FS
	default n
	help
	  The debugfs interface for kaslr feature.

config HONOR_HIDESYMS
	bool "hide symbols"
	default n
	help
	  Hide some sensitive kernel symbols

config HONOR_HIDESYMS_DEBUGFS
	bool "hide symbols debugfs interface"
	depends on HONOR_HIDESYMS && DEBUG_FS
	default n
	help
	  Turn on the debugfs interface for hide symbols

config HN_SLUB_SANITIZE
	bool "Sanitize Slub allocations"
	depends on SLUB
	default n
	help
         Zero fill slab allocations on free, reducing the lifetime of
         sensitive data and helping to mitigate use-after-free bugs.
         For slabs with debug poisoning enabling, this has no impact.

config HONOR_DOUBLE_FREE_CHECK_DEBUGFS
	bool "double free check debugfs interface"
	depends on DEBUG_FS
	default n
	help
	  The debugfs interface for double free check feature.

config HONOR_HARDEN_DOUBLE_FREE_CHECK_DEBUGFS
	bool "harden double free check debugfs interface"
	depends on DEBUG_FS
	default n
	help
	  The debugfs interface for harden double free check feature.

config HONOR_FREELIST_RANDOM_DEBUGFS
	bool "freelist random debugfs interface"
	depends on DEBUG_FS
	default n
	help
	  The debugfs interface for freelist random feature.

config HIDESYMS_CFI_JT
	bool "support .cfi_jf func of hidesyms"
	depends on HONOR_HIDESYMS && CFI_CLANG
	default n
	help
	  Hide some sensitive kernel symbols().
endmenu
#a blank line must be existed
```

## security/kernel_stp/Kconfig
```kconfig
#
# Copyright (c) Honor Device Co., Ltd. 2021-2021. All rights reserved.
# Description: Honor kernel stp selftest configuration
# Author: jiayunlong <jiayunlong@hihonor.com>
# Cryptographic API Configuration
# Create: 2021-08-30
#

menu "Honor KERNEL STP"

config HN_KERNEL_STP
	tristate "enables Honor KERNEL STP"
	default n
	help
	  This option enables support for Honor kernel stp in kernel space.
	  Honor kernel stp is a security threat perception module at kernel.
	  each source of threat can report the risk info to native throught the kernel stp

config HN_KERNEL_STP_ENG_DEBUG
	bool "Honor KERNEL STP for engineering mode debug"
	depends on HN_KERNEL_STP
	default n
	help
	  This option should only be enabled for engineering mode & debug test.
	  In engineering mode, more debug info can be print for tester.

endmenu
```
