/ {
	huawei-drg {
		compatible = "huawei,qcom-drg";
		huawei-drg0 {
			huawei,divider-cells = <1>;
			huawei,drg-master = <&CPU7 2284000>;
			huawei,drg-slave = <&CPU0 1478000
					    &CPU4 2112000>;
			up_limit_enable;
			thermal_enable;
		};
		huawei-drg1 {
			huawei,divider-cells = <1>;
			huawei,drg-master = <&CPU4 2112000>;
			huawei,drg-slave = <&CPU0 1478000>;
			user_mode_enable;
			up_limit_enable;
			thermal_enable;
		};
	};
};
